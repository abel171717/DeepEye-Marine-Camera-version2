## sdkconfig.defaults
```kconfig
# ESP32-S3 specific configuration
CONFIG_IDF_TARGET="esp32s3"
CONFIG_IDF_TARGET_ESP32S3=y

# PSRAM configuration for camera
CONFIG_ESP32S3_SPIRAM_SUPPORT=y
CONFIG_SPIRAM_MODE_OCT=y
CONFIG_SPIRAM_SPEED_80M=y

# Camera Configuration
CONFIG_OV2640_SUPPORT=y
CONFIG_CAMERA_CORE0=y
CONFIG_CAMERA_SCCB_CLK_FREQ=400000

# Increase JPEG buffer size for better quality
CONFIG_CAMERA_CUSTOM_JPEG_BUFFER_SIZE=y
CONFIG_CAMERA_CUSTOM_JPEG_BUFFER_SIZE_BYTES=2097152

# Flash and partition settings
CONFIG_ESPTOOLPY_FLASHSIZE_8MB=y
CONFIG_ESPTOOLPY_FLASHFREQ_80M=y
CONFIG_ESPTOOLPY_FLASHMODE_QIO=y

# FreeRTOS settings
CONFIG_FREERTOS_HZ=1000

# Log output
CONFIG_LOG_DEFAULT_LEVEL_INFO=y

# FAT Filesystem settings
CONFIG_FATFS_CODEPAGE_437=y
CONFIG_FATFS_LFN_HEAP=y
CONFIG_FATFS_MAX_LFN=255

# SPI settings for SD card
CONFIG_SPI_MASTER_ISR_IN_IRAM=y
```
